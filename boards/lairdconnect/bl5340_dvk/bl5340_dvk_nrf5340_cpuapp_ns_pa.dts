/*
 * Copyright (c) 2024 Ezurio
 *
 * SPDX-License-Identifier: Apache-2.0
 */

/dts-v1/;
#include "bl5340_dvk_nrf5340_cpuapp_ns.dts"

&gpio_fwd {
    nrf21540-gpio-if {
        gpios = <&gpio0 4 0>, /* antenna select */
                <&gpio0 31 0>, /* rx-en-gpios */
                <&gpio0 30 0>, /* tx-en-gpios */
                <&gpio0 29 0>; /* pdn-gpios */
    };
    nrf21540-spi-if {
        gpios = <&gpio1 0 0>, /* clk */
                <&gpio1 1 0>, /* mosi */
                <&gpio1 5 0>, /* csn */
                <&gpio1 4 0>; /* miso */
    };
};