## boards/lairdconnect/bl5340_dvk/board.yml
```yaml
board:
  name: bl5340_dvk
  vendor: lairdconnect
  socs:
    - name: "nrf5340"
      variants:
        - name: "pa"
          cpucluster: "cpuapp"
        - name: "pa"
          cpucluster: "cpunet"
        - name: "ns"
          cpucluster: "cpuapp"
          variants:
            - name: "pa"
```

## boards/lairdconnect/bl5340pa_dvk/board.yml
```yaml
board:
  name: bl5340pa_dvk
  vendor: lairdconnect
  socs:
  - name: 'nrf5340'
    variants:
    - name: 'ns'
      cpucluster: 'cpuapp'
```
