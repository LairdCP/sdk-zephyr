/*
 * Copyright (c) 2021-2024 Laird Connectivity
 *
 * SPDX-License-Identifier: Apache-2.0
 */

/dts-v1/;
#include <nordic/nrf5340_cpuappns_qkaa.dtsi>
#include "bl5340pa_dvk_nrf5340_cpuapp_common.dtsi"

/ {
	model = "Laird Connectivity BL5340PA (nRF5340 with nRF21540) Application";
	compatible = "lairdconnect,bl5340pa-dvk-cpuapp";

	chosen {
		zephyr,sram = &sram0_ns;
		zephyr,flash = &flash0;
		zephyr,code-partition = &slot0_ns_partition;
	};
};

zephyr_udc0: &usbd {
	compatible = "nordic,nrf-usbd";
	status = "okay";
};

&qspi {
	status = "disabled";

	/* Drop the flash and partitions to avoid the config being used for DFU
	 * samples.
	 */
	/delete-node/ mx25r6435f@0;
};
